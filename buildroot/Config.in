## buildroot/Config.in
```kconfig
source "$BR2_EXTERNAL_PX2_PATH/package/splash/Config.in"
source "$BR2_EXTERNAL_PX2_PATH/package/mesa3d-px2/Config.in"
source "$BR2_EXTERNAL_PX2_PATH/package/powerkey/Config.in"
source "$BR2_EXTERNAL_PX2_PATH/package/jackswitch/Config.in"
source "$BR2_EXTERNAL_PX2_PATH/package/tortos/Config.in"
source "$BR2_EXTERNAL_PX2_PATH/package/diatom/Config.in"
```

## buildroot/package/brick-kmods/Config.in
```kconfig
config BR2_PACKAGE_BRICK_KMODS
	bool "brick-kmods"
	depends on BR2_aarch64
	help
	  The TrimUI Brick's kernel modules, into /usr/lib/brick, where
	  /etc/init.d/brick loads them: the gamepad (brick-pad.ko) and
	  the GPU's kernel driver (pvrsrvkm.ko, dc_sunxi.ko,
	  Imagination's DDK 1.11 kernel half, dual MIT/GPL), and the
	  XR829's Wi-Fi driver with cfg80211 (cfg80211.ko, xr829_mac.ko,
	  xr829_core.ko, xr829_wlan.ko), which /etc/init.d/wpa_supplicant
	  loads when Wi-Fi is switched on.

	  Built outside Buildroot with the kernel they belong to, by make
	  brick-kernel (scripts/build-brick-kernel.sh), and taken from its
	  output in the build volume: the Brick's Allwinner 4.9 kernel
	  builds with GCC 10, not this toolchain's.
```

## buildroot/package/brick-rootswitch/Config.in
```kconfig
config BR2_PACKAGE_BRICK_ROOTSWITCH
	bool "brick-rootswitch"
	depends on BR2_aarch64
	help
	  The TrimUI Brick's initramfs program, /rdinit: it finds the
	  card's partition named plastron-root, mounts it and hands over
	  to its init. Built static; board/brick/post-image.sh packs it
	  into initramfs.cpio.gz.
```

## buildroot/package/brick-tools/Config.in
```kconfig
config BR2_PACKAGE_BRICK_TOOLS
	bool "brick-tools"
	help
	  Two small programs /etc/init.d/brick runs on the TrimUI Brick,
	  into /usr/lib/brick: backlight (on, off or a level, through the
	  Allwinner display driver), lit before each TortOS start; and
	  sincereset, which logs how long the boot took before the
	  kernel, from the timer that counts from reset.
```

## buildroot/package/brrr/Config.in
```kconfig
config BR2_PACKAGE_BRRR
	bool "brrr"
	select BR2_PACKAGE_LIBDRM
	help
	  Says "TortOS go brrr" on the screen at boot, until TortOS has a
	  boot animation of its own. The kernel leaves the panel dark (see
	  board/px2/boot.cmd), so this is also the first thing to light it.
```

## buildroot/package/diatom/Config.in
```kconfig
config BR2_PACKAGE_DIATOM
	bool "diatom"
	depends on BR2_PACKAGE_SDL2
	depends on BR2_PACKAGE_MESA3D_PX2 || BR2_PACKAGE_PVR_GE8300
	select BR2_PACKAGE_ZLIB
	help
	  Diatom, the libretro frontend TortOS runs games with, built
	  from its repository (mounted at /diatom in the build
	  container) with its Pixel 2 port, or its Brick port on the
	  TrimUI Brick's system.
```

## buildroot/package/gauge/Config.in
```kconfig
config BR2_PACKAGE_GAUGE
	bool "gauge"
	help
	  Shows the battery on the four lights on the side: a bar filling
	  while charging, a red flash when the battery is low, and the level
	  when asked (SIGUSR1). Started by init, with respawn.
```

## buildroot/package/jackswitch/Config.in
```kconfig
config BR2_PACKAGE_JACKSWITCH
	bool "jackswitch"
	depends on BR2_PACKAGE_ALSA_LIB
	help
	  Sends sound to the headphones while they're plugged in and to
	  the speaker otherwise. Started by init, with respawn.
```

## buildroot/package/mesa3d-px2/Config.in
```kconfig
config BR2_PACKAGE_MESA3D_PX2
	bool "mesa3d-px2"
	depends on !BR2_PACKAGE_MESA3D
	depends on BR2_INSTALL_LIBSTDCPP
	depends on BR2_TOOLCHAIN_HAS_THREADS
	select BR2_PACKAGE_EXPAT
	select BR2_PACKAGE_LIBDRM
	select BR2_PACKAGE_ZLIB
	select BR2_PACKAGE_HAS_LIBEGL
	select BR2_PACKAGE_HAS_LIBGLES
	select BR2_PACKAGE_HAS_LIBGBM
	select BR2_PACKAGE_LIBGBM_HAS_FEATURE_FORMAT_MODIFIER_PLANE_COUNT
	select BR2_PACKAGE_LIBGBM_HAS_FEATURE_DMA_BUF
	help
	  Mesa with only what the Pixel 2 needs: the Panfrost driver for its
	  Mali-G31, GBM and EGL for drawing straight to the display, and
	  OpenGL ES. Buildroot's own mesa3d ties Panfrost to building LLVM
	  and clang for the device, because Mesa 25.1 and later precompile
	  some Panfrost GPU kernels at build time. 25.0 doesn't, so this
	  package pins it.

if BR2_PACKAGE_MESA3D_PX2

config BR2_PACKAGE_PROVIDES_LIBEGL
	default "mesa3d-px2"

config BR2_PACKAGE_PROVIDES_LIBGLES
	default "mesa3d-px2"

config BR2_PACKAGE_PROVIDES_LIBGBM
	default "mesa3d-px2"

endif
```

## buildroot/package/powerkey/Config.in
```kconfig
config BR2_PACKAGE_POWERKEY
	bool "powerkey"
	help
	  A press of the power button shuts the device down cleanly
	  (poweroff when it's let go). Started by init, with respawn.
```

## buildroot/package/pvr-ge8300/Config.in
```kconfig
config BR2_PACKAGE_PVR_GE8300
	bool "pvr-ge8300"
	depends on BR2_aarch64
	depends on BR2_TOOLCHAIN_USES_GLIBC
	select BR2_PACKAGE_HAS_LIBEGL
	select BR2_PACKAGE_HAS_LIBGLES
	help
	  Imagination's OpenGL ES and EGL for the PowerVR GE8300 in the
	  TrimUI Brick's Allwinner A133P: the userspace half of DDK
	  1.11@5516664, the version the kernel's GPU driver is built
	  from, with the null window system that draws to the Linux
	  framebuffer, and the GPU's firmware.

	  Imagination's closed binaries, under Imagination's own terms: they
	  are not part of plastron, are never committed, and come with no
	  license from us. The build takes them from a folder mounted at
	  /brick-gpu (BRICK_GPU in the Makefile, ~/brick-runtime/gpu-ddk-1.11
	  by default), laid out as:

	    lib64/      libEGL.so libGLESv2.so libGLES_CM.so libIMGegl.so
	                libsrv_um.so libglslcompiler.so libusc.so
	                libpvrNULL_WSEGL.so
	    lib64/firmware/rgx.fw.22.102.54.38
	    include/    the Khronos headers: EGL, KHR, GLES, GLES2, GLES3

	  They are the Imagination PowerVR DDK 1.11@5516664 userspace
	  libraries for the GE8300 (fbdev window system, glibc, aarch64),
	  as Allwinner ships them in its A133 SDKs. Nothing else will do:
	  they must match the kernel's GPU driver exactly, and other copies
	  around (TrimUI's are DDK 1.19) don't. The build checks each file
	  against files.sha256 and stops on any difference.

if BR2_PACKAGE_PVR_GE8300

config BR2_PACKAGE_PROVIDES_LIBEGL
	default "pvr-ge8300"

config BR2_PACKAGE_PROVIDES_LIBGLES
	default "pvr-ge8300"

endif
```

## buildroot/package/sdltest/Config.in
```kconfig
config BR2_PACKAGE_SDLTEST
	bool "sdltest"
	depends on BR2_PACKAGE_SDL2_KMSDRM && BR2_PACKAGE_SDL2_OPENGLES
	help
	  Times how long SDL2 takes to come up the way TortOS uses it
	  (KMS/DRM, OpenGL ES renderer) and checks that presenting a
	  rotated landscape frame keeps full speed. "sdltest [frames]".
```

## buildroot/package/splash/Config.in
```kconfig
config BR2_PACKAGE_SPLASH
	bool "splash"
	select BR2_PACKAGE_LIBDRM if !BR2_PACKAGE_PVR_GE8300
	select BR2_PACKAGE_ZLIB if BR2_PACKAGE_PVR_GE8300
	help
	  TortOS's boot animation, from the moment the panel lights until
	  TortOS takes the display over - which it does as soon as it is
	  ready, never waiting for the animation. The kernel leaves the
	  panel dark (see board/px2/boot.cmd), so this is also the first
	  thing to light it.

	  On the TrimUI Brick (with pvr-ge8300) it is splash-fb, which draws
	  on the framebuffer instead, from the moment it exists.
```

## buildroot/package/tortos/Config.in
```kconfig
config BR2_PACKAGE_TORTOS
	bool "tortos"
	depends on BR2_PACKAGE_SDL2_IMAGE
	depends on BR2_PACKAGE_SDL2_TTF
	depends on BR2_PACKAGE_FFMPEG
	select BR2_PACKAGE_SQLITE
	select BR2_PACKAGE_ALSA_LIB
	select BR2_PACKAGE_ZLIB
	help
	  The TortOS launcher (tortos) and its music engine (muse),
	  built from the TortOS repository, mounted at /tortos in the
	  build container.
```

## buildroot/package/usbrole/Config.in
```kconfig
config BR2_PACKAGE_USBROLE
	bool "usbrole"
	help
	  Makes the USB port a host while something that wants power is
	  plugged into it (a USB-C DAC), and a device otherwise, by the
	  ID pin. Started by init, with respawn.
```

## buildroot/package/xr829-firmware/Config.in
```kconfig
config BR2_PACKAGE_XR829_FIRMWARE
	bool "xr829-firmware"
	help
	  The firmware the TrimUI Brick's XR829 Wi-Fi and Bluetooth chip
	  runs, which its drivers upload when the radio is switched on:
	  boot_xr829.bin, fw_xr829.bin and sdd_xr829.bin for Wi-Fi (the
	  Wi-Fi driver opens them in /lib/firmware by name), and
	  fw_xr829_bt.bin for Bluetooth. The sdd file and the Bluetooth
	  firmware are the ones for a 24 MHz crystal, the Brick's.

	  XRadio's closed binaries, with no license stated: they are not
	  part of plastron, are never committed, and come with no license
	  from us. The build takes them from a folder mounted at
	  /brick-xr829 (BRICK_XR829 in the Makefile, ~/brick-runtime/xr829
	  by default), as Creality's Sonic Pad SDK has them
	  (github.com/CrealityTech/sonic_pad_os at 7f37a7f,
	  package/firmware/linux-firmware/xr829). The build checks each
	  file against files.sha256 before installing anything.
```
